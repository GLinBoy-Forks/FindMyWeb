## firmware/src/fruitytag/Kconfig
```kconfig
module = FRUITYTAG
module-str = fruitytag
source "subsys/logging/Kconfig.template.log_config"
```

## firmware/src/keystore/Kconfig
```kconfig
module = KEYSTORE
module-str = keystore
source "subsys/logging/Kconfig.template.log_config"
```
